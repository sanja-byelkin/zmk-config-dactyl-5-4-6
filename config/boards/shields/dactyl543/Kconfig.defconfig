## config/boards/shields/dactyl543/Kconfig.defconfig
```kconfig
# Copyright (c) 2022 The ZMK Contributors
# SPDX-License-Identifier: MIT

if SHIELD_DACTYL543_LEFT

config ZMK_KEYBOARD_NAME
    default "DACTYL543"

config ZMK_SPLIT_ROLE_CENTRAL
    default y

endif

if SHIELD_DACTYL543_LEFT || SHIELD_DACTYL543_RIGHT

config ZMK_SPLIT
    default y

endif
```

## config/boards/shields/dactyl543/Kconfig.shield
```kconfig
# Copyright (c) 2022 The ZMK Contributors
# SPDX-License-Identifier: MIT

config SHIELD_DACTYL543_LEFT
    def_bool $(shields_list_contains,dactyl543_left)

config SHIELD_DACTYL543_RIGHT
    def_bool $(shields_list_contains,dactyl543_right)
```

## config/boards/shields/dactyl546/Kconfig.shield
```kconfig
# Copyright (c) 2022 The ZMK Contributors
# SPDX-License-Identifier: MIT

config SHIELD_DACTYL546_LEFT
    def_bool $(shields_list_contains,dactyl546_left)

config SHIELD_DACTYL546_RIGHT
    def_bool $(shields_list_contains,dactyl546_right)
```
